## components/SDL/Kconfig.projbuild
```kconfig
menu "ESP32-DUKE3D platform-specific configuration"

choice DUKE3D_HARDWARE
	prompt "Hardware to run on"
	default HW_WROVERKIT_V2
	help
		This game can run on various types of hardware. Select what you have here. Warning: The hardware does need to have 4MiB PSRAM installed

config HW_WROVERKIT_V1
	bool "ESP_Wrover_Kit v1 (red PCB)"

config HW_WROVERKIT_V2
	bool "ESP_Wrover_Kit v2/v3 (shiny/matte black PCB)"

config HW_CUSTOM
	bool "Custom hardware"

endchoice

choice HW_LCD_TYPE_SEL
	prompt "LCD type"
	default HW_LCD_TYPE_ILI
	depends on HW_CUSTOM || HW_WROVERKIT_V2

config HW_LCD_TYPE_ILI
	bool "ILI9341 LCD"

config HW_LCD_TYPE_ST
	bool "ST7789V LCD"

endchoice

config HW_WROVERKIT
	bool
	default n if HW_CUSTOM
	default y if HW_WROVERKIT_V1
	default y if HW_WROVERKIT_V2


config HW_LCD_TYPE
	int
	default 0 if HW_WROVERKIT_V1
	default 0 if HW_LCD_TYPE_ILI
	default 1 if HW_LCD_TYPE_ST

config HW_LCD_MISO_GPIO_CUST
	int "LCD MISO pin"
	depends on HW_CUSTOM
	range 1 35
	default 19

config HW_LCD_MOSI_GPIO_CUST
	int "LCD MOSI pin"
	depends on HW_CUSTOM
	range 1 35
	default 23


config HW_LCD_CLK_GPIO_CUST
	int "LCD CLK pin"
	depends on HW_CUSTOM
	range 1 35
	default 18

config HW_LCD_CS_GPIO_CUST
	int "LCD CS pin"
	depends on HW_CUSTOM
	range 1 35
	default 5

config HW_LCD_DC_GPIO_CUST
	int "LCD DC pin"
	depends on HW_CUSTOM
	range 1 35
	default 22

config HW_LCD_RESET_GPIO_CUST
	int "LCD RESET pin"
	depends on HW_CUSTOM
	range 1 35
	default 21

config HW_LCD_BL_GPIO_CUST
	int "LCD Backlight Enable pin"
	depends on HW_CUSTOM
	range 1 35
	default 5

config HW_INV_BL_CUST
	bool "Invert backlight output"
	default n
	depends on HW_CUSTOM


config HW_INV_BL
	bool
	default HW_INBV_BL_CUST if HW_CUSTOM
	default n if HW_WROVERKIT_V1
	default y if HW_WROVERKIT_V2

config HW_LCD_MISO_GPIO
	int
	default HW_LCD_MISO_GPIO_CUST if HW_CUSTOM
	default 19 if HW_WROVERKIT
	
config HW_LCD_MOSI_GPIO
	int
	default HW_LCD_MOSI_GPIO_CUST if HW_CUSTOM
	default 23 if HW_WROVERKIT

config HW_LCD_CLK_GPIO
	int
	default HW_LCD_CLK_GPIO_CUST if HW_CUSTOM
	default 18 if HW_WROVERKIT

config HW_LCD_CS_GPIO
	int
	default HW_LCD_CS_GPIO_CUST if HW_CUSTOM
	default 5 if HW_WROVERKIT

config HW_LCD_DC_GPIO
	int
	default HW_LCD_DC_GPIO_CUST if HW_CUSTOM
	default 22 if HW_WROVERKIT

config HW_LCD_RESET_GPIO
	int
	default HW_LCD_RESET_GPIO_CUST if HW_CUSTOM
	default 21 if HW_WROVERKIT

config HW_LCD_BL_GPIO
	int
	default HW_LCD_BL_GPIO_CUST if HW_CUSTOM
	default -1 if HW_WROVERKIT

config HW_SD_PIN_NUM_MISO
	int "SD Card MISO"
	range 1 35
	default 2

config HW_SD_PIN_NUM_MOSI
	int "SD Card MOSI"
	range 1 35
	default 13

config HW_SD_PIN_NUM_CLK
	int "SD Card CLK"
	range 1 35
	default 14

config HW_SD_PIN_NUM_CS
	int "SD Card CS"
	range 1 35
	default 15
	
endmenu
```
